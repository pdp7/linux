## Documentation/devicetree/bindings/net/thead,dwmac.yaml
```yaml
# SPDX-License-Identifier: (GPL-2.0-only OR BSD-2-Clause)
%YAML 1.2
---
$id: http://devicetree.org/schemas/net/thead,dwmac.yaml#
$schema: http://devicetree.org/meta-schemas/core.yaml#

title: T-HEAD DWMAC Ethernet controller

maintainers:
  - Jisheng Zhang <jszhang@kernel.org>

select:
  properties:
    compatible:
      contains:
        enum:
          - thead,th1520-dwmac
  required:
    - compatible

properties:
  compatible:
    items:
      - enum:
          - thead,th1520-dwmac
      - const: snps,dwmac-3.70a

  reg:
    minItems: 2
    maxItems: 2
    items:
      - description: DesignWare GMAC IP core registers
      - description: GMAC APB registers

  reg-names:
    minItems: 2
    maxItems: 2
    items:
      - const: dwmac
      - const: apb

required:
  - compatible
  - reg
  - clocks
  - clock-names
  - interrupts
  - interrupt-names
  - phy-mode

allOf:
  - $ref: snps,dwmac.yaml#

unevaluatedProperties: false

examples:
  - |
    gmac0: ethernet@e7070000 {
        compatible = "thead,th1520-dwmac", "snps,dwmac-3.70a";
        reg = <0xe7070000 0x2000>, <0xec003000 0x1000>;
        reg-names = "dwmac", "apb";
        clocks = <&clk 1>, <&clk 2>;
        clock-names = "stmmaceth", "pclk";
        interrupts = <66>;
        interrupt-names = "macirq";
        phy-mode = "rgmii-id";
        snps,fixed-burst;
        snps,axi-config = <&stmmac_axi_setup>;
        snps,pbl = <32>;
        phy-handle = <&phy0>;

        mdio {
            #address-cells = <1>;
            #size-cells = <0>;
            compatible = "snps,dwmac-mdio";

            phy0: ethernet-phy@0 {
                reg = <0>;
            };
        };
    };
```
